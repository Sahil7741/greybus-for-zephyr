## prj.conf
```kconfig
CONFIG_HEAP_MEM_POOL_SIZE=16384
CONFIG_NEWLIB_LIBC=y

# Serial (required for XPORT_UART)
CONFIG_SERIAL=y

# Greybus options and dependencies
CONFIG_GREYBUS=y
CONFIG_GREYBUS_CONTROL=y
CONFIG_GREYBUS_XPORT_UART=y
CONFIG_POSIX_THREADS=y
# CONFIG_POSIX_THREADS_DYNAMIC_STACK=y
CONFIG_THREAD_NAME=y
CONFIG_POSIX_THREAD_THREADS_MAX=16

# Console options
CONFIG_CONSOLE_SUBSYS=y
CONFIG_CONSOLE_GETCHAR=y

# Kernel options
CONFIG_MAIN_STACK_SIZE=1024
CONFIG_ENTROPY_GENERATOR=y
CONFIG_INIT_STACKS=y

# Logging
CONFIG_LOG=y
CONFIG_PRINTK=y

# Pthread options
CONFIG_POSIX_THREAD_THREADS_MAX=16
CONFIG_RING_BUFFER=y
```

## src/main.c
```c
/*
 * Copyright (c) 2109 Friedt Professional Engineering Services, Inc
 *
 * SPDX-License-Identifier: BSD-3-Clause
 */

#include <stdio.h>
#include <zephyr/kernel.h>

int main(void)
{
  return 0;
}
```
