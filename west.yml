## west.yml
```yaml
manifest:
  self:
    path: greybus
  remotes:
    - name: zephyrproject-rtos
      url-base: https://github.com/zephyrproject-rtos
  projects:
    - name: zephyr
      remote: zephyrproject-rtos
      revision: main
      import:
        name-allowlist:
          - hal_ti
          - cmsis
```
